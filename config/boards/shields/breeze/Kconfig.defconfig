## config/boards/shields/breeze/Kconfig.defconfig
```kconfig
if SHIELD_BREEZE_LEFT

config ZMK_KEYBOARD_NAME
    default "Breeze MK"

config ZMK_SPLIT_ROLE_CENTRAL
    default y

endif

if SHIELD_BREEZE_LEFT || SHIELD_BREEZE_RIGHT

config ZMK_SPLIT
    default y

config CONFIG_ZMK_SLEEP
    bool
    default y

config CONFIG_ZMK_IDLE_SLEEP_TIMEOUT
    int
    default 3600000

config CONFIG_ZMK_HID_REPORT_TYPE_NKRO
    int
    default 5

endif

CONFIG_ZMK_HID_REPORT_TYPE_NKRO = 5
```
